#include <Wire.h>
#include <Adafruit_GFX.h>
#include <Adafruit_SSD1306.h>

#define SCREEN_I2C_ADDR 0x3C  // Use 0x3C for most OLEDs
#define SCREEN_WIDTH 128
#define SCREEN_HEIGHT 64
#define OLED_RST_PIN -1

Adafruit_SSD1306 display(SCREEN_WIDTH, SCREEN_HEIGHT, &Wire, OLED_RST_PIN);

// LinkedIn Animation Frames
#define FRAME_DELAY 42
#define FRAME_WIDTH 64
#define FRAME_HEIGHT 64
#define FRAME_COUNT 24

const uint8_t PROGMEM frames[][512] = {
  {0,0,0,0,0,0,0,0,0,0,0,0,0,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0,0},
  {0,0,0,0,0,0,0,0,0,0,0,0,0,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0,0},
  {0,0,0,0,0,0,0,0,0,0,0,0,0,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0,0},
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  {0,0,0,0,0,0,0,0,0,0,0,0,0,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0,0}
};

// Your LinkedIn QR Code
const unsigned char epd_bitmap_qrcode_282351431_7db8d2b01252ea380bafe8bcf94bda9a__1_ [] PROGMEM = {
	0x00, 0x00, 0x00, 0x00, 0xff, 0xff, 0xff, 0xff, 0xff, 0xff, 0xff, 0xff, 0x00, 0x00, 0x00, 0x00, 
	0x00, 0x00, 0x00, 0x00, 0xff, 0xff, 0xff, 0xff, 0xff, 0xff, 0xff, 0xff, 0x00, 0x00, 0x00, 0x00, 
	0x00, 0x00, 0x00, 0x00, 0xff, 0xff, 0xff, 0xff, 0xff, 0xff, 0xff, 0xff, 0x00, 0x00, 0x00, 0x00, 
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	0x00, 0x00, 0x00, 0x00, 0xff, 0xff, 0xff, 0xff, 0xff, 0xff, 0xff, 0xff, 0x00, 0x00, 0x00, 0x00
};

void setup() {
  Serial.begin(115200);
  
  // Initialize OLED
  if(!display.begin(SSD1306_SWITCHCAPVCC, SCREEN_I2C_ADDR)) {
    Serial.println(F("SSD1306 allocation failed"));
    for(;;);
  }
  
  display.clearDisplay();
  display.setTextColor(SSD1306_WHITE);
  Serial.println("OLED initialized - LinkedIn Display");
}

void loop() {
  // Show LinkedIn icon animation for 5 seconds
  showLinkedInAnimation();
  delay(100); // Small delay between transitions
  
  // Show QR code for 20 seconds
  showQRCode();
  delay(100); // Small delay between transitions
}

void showLinkedInAnimation() {
  unsigned long startTime = millis();
  unsigned long duration = 5000; // 5 seconds
  
  Serial.println("Showing LinkedIn Animation...");
  
  while(millis() - startTime < duration) {
    for(int frame = 0; frame < FRAME_COUNT; frame++) {
      if(millis() - startTime >= duration) break; // Check if time's up
      
      display.clearDisplay();
      
      // Center the animation
      int xPos = (SCREEN_WIDTH - FRAME_WIDTH) / 2;
      int yPos = (SCREEN_HEIGHT - FRAME_HEIGHT) / 2;
      
      // Draw animation frame
      display.drawBitmap(xPos, yPos, frames[frame], FRAME_WIDTH, FRAME_HEIGHT, SSD1306_WHITE);
      
      // Add title
      display.setTextSize(1);
      display.setCursor(40, 0);
      display.print("LinkedIn");
      
      display.display();
      delay(FRAME_DELAY);
    }
  }
}

void showQRCode() {
  unsigned long startTime = millis();
  unsigned long duration = 20000; // 20 seconds
  
  Serial.println("Showing QR Code...");
  
  while(millis() - startTime < duration) {
    display.clearDisplay();
    
    // Center the QR code (128x64 QR on 128x64 display)
    display.drawBitmap(0, 0, epd_bitmap_qrcode_282351431_7db8d2b01252ea380bafe8bcf94bda9a__1_, 128, 64, SSD1306_WHITE);
    

    
    display.display();
    
    // Small delay to prevent flickering
    delay(100);
  }
}

// Utility function to display centered text
void displayCenteredText(String text, int y, int textSize = 1) {
  display.setTextSize(textSize);
  int x = (SCREEN_WIDTH - text.length() * 6 * textSize) / 2;
  display.setCursor(x, y);
  display.print(text);
}
